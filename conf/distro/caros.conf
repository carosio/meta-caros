## conf/distro/caros.conf
```bitbake
require conf/distro/poky.conf

DISTRO = "caros"
DISTRO_NAME = "CarOS"
DISTRO_VERSION = "15.03"
SDK_VENDOR = "-carossdk"
SDK_VERSION = "${@'${DISTRO_VERSION}'.replace('snapshot-${DATE}','snapshot')}"

MAINTAINER = "Travelping GmbH <info@travelping.com>"

TARGET_VENDOR = "-caros"

WARN_QA_append = " erlang-rprovide erlang-rdepends"

require conf/distro/include/security_flags.inc
SECURITY_CFLAGS_pn-lmsensors = "${SECURITY_NO_PIE_CFLAGS}"
SECURITY_CFLAGS_pn-lcdproc = "${SECURITY_NO_PIE_CFLAGS}"
SECURITY_CFLAGS_pn-btrfs-tools = "${SECURITY_NO_PIE_CFLAGS}"
SECURITY_CFLAGS_pn-iperf3 = "${SECURITY_NO_PIE_CFLAGS}"
SECURITY_CFLAGS_pn-zeromq = "${SECURITY_NO_PIE_CFLAGS}"

VIRTUAL-RUNTIME_init_manager = "systemd"
VIRTUAL-RUNTIME_initscripts = ""

PREFERRED_PROVIDER_udev ?= "systemd"
PREFERRED_PROVIDER_udev-utils ?= "systemd"
BAD_RECOMMENDATIONS ?= "busybox-syslog python-readline"

DISTRO_FEATURES_DEFAULT ?= "systemd argp ext2 largefile usbhost xattr nfs pci"
DISTRO_FEATURES ?= "${DISTRO_FEATURES_DEFAULT} ${DISTRO_FEATURES_LIBC}"
DISTRO_FEATURES_BACKFILL_CONSIDERED = "sysvinit"

EXTRAOPKGCONFIG = "caros-feed-config-opkg"
FEEDDOMAIN ??= "http://dl.caros.io"

# Disable wide char support for ncurses as we don't include it in
# in the LIBC features below.
ENABLE_WIDEC="false"

# Drop native language support. This removes the
# eglibc->bash->gettext->libc-posix-clang-wchar dependency.
USE_NLS="no"

IMAGE_FSTYPES ?= "live"

PACKAGECONFIG_append_pn-systemd = " resolved networkd"

PACKAGECONFIG_append_pn-opkg = " curl ssl-curl openssl"
PACKAGECONFIG_remove_pn-curl = "gnutls"
PACKAGECONFIG_append_pn-curl = " ssl"
```

## conf/distro/tplino.conf
```bitbake
require conf/distro/poky.conf

DISTRO = "tplino"
DISTRO_NAME = "TPLINO"
DISTRO_VERSION = "6.1.0"
SDK_VENDOR = "-tplinosdk"
SDK_VERSION = "${@'${DISTRO_VERSION}'.replace('snapshot-${DATE}','snapshot')}"

MAINTAINER = "Travelping GmbH <info@travelping.com>"

TARGET_VENDOR = "-tplino"

BUILD_CPPFLAGS += "-fstack-protector"

VIRTUAL-RUNTIME_init_manager = "systemd"
VIRTUAL-RUNTIME_initscripts = ""

PREFERRED_PROVIDER_udev ?= "systemd"
PREFERRED_PROVIDER_udev-utils ?= "systemd"
BAD_RECOMMENDATIONS ?= "busybox-syslog python-readline"

DISTRO_FEATURES_DEFAULT ?= "systemd argp ext2 largefile usbhost xattr nfs pci"
DISTRO_FEATURES ?= "${DISTRO_FEATURES_DEFAULT} ${DISTRO_FEATURES_LIBC}"
DISTRO_FEATURES_BACKFILL_CONSIDERED = "sysvinit"

EXTRAOPKGCONFIG = "tplino-feed-config-opkg"
FEEDDOMAIN ??= "http://download.tplino.net"

# Disable wide char support for ncurses as we don't include it in
# in the LIBC features below.
ENABLE_WIDEC="false"

# Drop native language support. This removes the
# eglibc->bash->gettext->libc-posix-clang-wchar dependency.
USE_NLS="no"

IMAGE_FSTYPES ?= "live"

PREFERRED_PROVIDER_virtual/erlang = "erlang"
PREFERRED_PROVIDER_virtual/erlang-native = "erlang-native"

PACKAGECONFIG_append_pn-systemd = " resolved networkd"
```

## conf/layer.conf
```bitbake
# We have a conf and classes directory, add to BBPATH
BBPATH := "${BBPATH}:${LAYERDIR}"

# We have a recipes directory, add to BBFILES
BBFILES := "${BBFILES} ${LAYERDIR}/recipes-*/*/*.bb \
	${LAYERDIR}/recipes-*/*/*.bbappend"

BBFILE_COLLECTIONS += "caros"
BBFILE_PATTERN_caros := "^${LAYERDIR}/"
BBFILE_PRIORITY_caros = "9"

# Additional license directories.
LICENSE_PATH += "${LAYERDIR}/files/custom-licenses"
APP_CONTROL_FILES = "${LAYERDIR}/files/caros_service_class"
REBAR_FILES = "${LAYERDIR}/files/rebar_class"
```

## conf/machine/include/tune-gulftown.inc
```bitbake
DEFAULTTUNE ?= "gulftown-64"

require conf/machine/include/tune-core2.inc

# Extra tune features
TUNEVALID[gulftown] = "Enable gulftown specific processor optimizations"
TUNE_CCARGS += "${@bb.utils.contains("TUNE_FEATURES", "gulftown", "-march=corei7 -maes -mfpmath=sse -mpclmul -mpopcnt -mcx16 -msahf -mtls-dialect=gnu2", "", d)}"

# Extra tune selections
AVAILTUNES += "gulftown"
TUNE_FEATURES_tune-gulftown = "${TUNE_FEATURES_tune-x86} gulftown"
BASE_LIB_tune-gulftown = "lib"
TUNE_PKGARCH_tune-gulftown = "gulftown"
PACKAGE_EXTRA_ARCHS_tune-gulftown = "${PACKAGE_EXTRA_ARCHS_tune-x86} i386 i486 i586 i686 core2 gulftown"

AVAILTUNES += "gulftown-64"
TUNE_FEATURES_tune-gulftown-64 = "${TUNE_FEATURES_tune-x86-64} gulftown"
BASE_LIB_tune-gulftown-64 = "lib64"
TUNE_PKGARCH_tune-gulftown-64 = "gulftown_64"
PACKAGE_EXTRA_ARCHS_tune-gulftown-64 = "${PACKAGE_EXTRA_ARCHS_tune-x86-64} core2_64 gulftown_64"

AVAILTUNES += "gulftown-64-x32"
TUNE_FEATURES_tune-gulftown-64-x32 = "${TUNE_FEATURES_tune-x86-64-x32} gulftown"
BASE_LIB_tune-gulftown-64-x32 = "libx32"
TUNE_PKGARCH_tune-gulftown-64-x32 = "gulftown_64_x32"
PACKAGE_EXTRA_ARCHS_tune-gulftown-64-x32 = "${PACKAGE_EXTRA_ARCHS_tune-x86-64-x32} core2_64_x32 gulftown_64_x32"
```

## meta-tplino/conf/distro/tplino.conf
```bitbake
require conf/distro/poky.conf

DISTRO = "tplino"
DISTRO_NAME = "TPLINO"
DISTRO_VERSION = "6.0+snapshot-${DATE}"
SDK_VENDOR = "-tplinosdk"
SDK_VERSION := "${@'${DISTRO_VERSION}'.replace('snapshot-${DATE}','snapshot')}"

MAINTAINER = "Travelping GmbH <info@travelping.com>"

TARGET_VENDOR = "-tplino"

BUILD_CPPFLAGS += "-fstack-protector"
#

DISTRO_FEATURES_INITMAN = "systemd"
DISTRO_FEATURES = "argp ext2 largefile usbhost xattr nfs zeroconf pci systemd erlang ${DISTRO_FEATURES_LIBC}"
MACHINE_EXTRA_RDEPENDS += "ethtool strace gdbserver"
EXTRAOPKGCONFIG = ""

# Disable wide char support for ncurses as we don't include it in
# in the LIBC features below.
ENABLE_WIDEC="false"

# Drop native language support. This removes the
# eglibc->bash->gettext->libc-posix-clang-wchar dependency.
USE_NLS="no"

IMAGE_FSTYPES = "live"
```

## meta-tplino/conf/layer.conf
```bitbake
# We have a conf and classes directory, add to BBPATH
BBPATH := "${BBPATH}:${LAYERDIR}"

# We have a recipes directory, add to BBFILES
BBFILES := "${BBFILES} ${LAYERDIR}/recipes-*/*/*.bb \
	${LAYERDIR}/recipes-*/*/*.bbappend"

BBFILE_COLLECTIONS += "tplino"
BBFILE_PATTERN_tplino := "^${LAYERDIR}/"
BBFILE_PRIORITY_tplino = "6"

BBMASK = ".*/meta/recipes-graphics/ .*/meta/recipes-gnome/ .*/meta/recipes-qt/"
```
